#include "renseki.dtsi"

&default_transform {
    col-offset = <5>;
};

&kscan0 {
    /* * Right Hand Matrix
     * Rows: 0, 14, 16, 8
     * Cols: 20, 19, 18, 15, 1
     */
    row-gpios
        = <&pro_micro 0  (GPIO_ACTIVE_HIGH | GPIO_PULL_DOWN)>
        , <&pro_micro 14 (GPIO_ACTIVE_HIGH | GPIO_PULL_DOWN)>
        , <&pro_micro 16 (GPIO_ACTIVE_HIGH | GPIO_PULL_DOWN)>
        , <&pro_micro 8  (GPIO_ACTIVE_HIGH | GPIO_PULL_DOWN)>
        ;

    col-gpios
        = <&pro_micro 20 GPIO_ACTIVE_HIGH>
        , <&pro_micro 19 GPIO_ACTIVE_HIGH>
        , <&pro_micro 18 GPIO_ACTIVE_HIGH>
        , <&pro_micro 15 GPIO_ACTIVE_HIGH>
        , <&pro_micro 1  GPIO_ACTIVE_HIGH>
        ;
};